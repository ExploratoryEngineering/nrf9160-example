## CMakeLists.txt
```
#
# Copyright (c) 2019 Exploratory Engineering
#

cmake_minimum_required(VERSION 3.8.2)

include($ENV{ZEPHYR_BASE}/cmake/app/boilerplate.cmake NO_POLICY_SCOPE)
project(NONE)

target_sources(app PRIVATE src/main.c)
zephyr_include_directories(src)

zephyr_library_include_directories(
	src/ui
	src/orientation_detector
  )

  add_subdirectory(src/ui)
  add_subdirectory(src/orientation_detector)
```

## Kconfig
```
#
# Copyright (c) 2018 Nordic Semiconductor ASA
#
# SPDX-License-Identifier: LicenseRef-BSD-5-Clause-Nordic
#

menu "Thingy example"

menu "Motion"

choice
	prompt "Accelerometer device"
	default ACCEL_USE_SIM
	help
		Select which device will provide accelerometer data.

config ACCEL_USE_SIM
	bool "Use simulated accelerometer data"
	select SENSOR
	select SENSOR_SIM
	select SENSOR_SIM_TRIGGER
	select SENSOR_SIM_STATIC_VALUES
	help
		Use sensor simulator to generate accelerometer data for
		flip detection data sent to nRF Cloud.

config ACCEL_USE_EXTERNAL
	bool "User provided accelerometer device"
	help
		The user will provide an accelerometer device that will
		be used for flip detection.

endchoice

if ACCEL_USE_SIM
config ACCEL_DEV_NAME
	string
	default SENSOR_SIM_DEV_NAME

config ACCEL_TRIGGER
	bool
	default SENSOR_SIM_TRIGGER

config FLIP_INPUT
	int "Button or switch number to simulate flip"
	range 1 4 if BOARD_NRF9160_PCA10090NS
	range 1 1 if BOARD_NRF9160_PCA20035NS
	default 3 if BOARD_NRF9160_PCA10090NS
	default 1 if BOARD_NRF9160_PCA20035NS
	help
		Button or switch number to use for simulating
		a board flip event.
		1 - Button 1
		2 - Button 2
		3 - Switch 1
		4 - Switch 2
endif

config FLIP_POLL
	bool "Use polling to detect flip"
	help
		Poll the defined accelerometer device at interval determined by
		FLIP_POLL_INTERVAL. Data will be sent to nRF Cloud if a flip
		has happened and the orientation thus has changed.

if FLIP_POLL
config FLIP_POLL_INTERVAL
	int "Flip detection poll interval"
	default 1000
	help
		Flip polling interval in milliseconds.
endif

if ACCEL_USE_EXTERNAL

config ACCEL_DEV_NAME
	string "Accelerometer device name"
	help
		Device from which accelerometer data will be fetched and used
		for orientation detection and sent to nRF Cloud.

endif

config ACCEL_INVERTED
	bool "Accelerometer inverted"
	default y if BOARD_NRF9160_PCA20035NS
	help
		Enable if the accelerometer is mounted with the top side facing
		down when the board itself is in normal position.

config ACCEL_CALIBRATE
	bool "Calibrate accelerometer"
	help
		Calibrate the accelerometer on a flat surface to filter away
		static measurement offset that could affect orientation
		detection.

if ACCEL_CALIBRATE
config ACCEL_CALIBRATION_ITERATIONS
	int "Number of readings for calibration"
	default 20 if BOARD_NRF9160_PCA20035NS
	help
		Number of measurement readings to average over to find the
		static offset in the readings when calibrating the
		accelerometer.

config CALIBRATION_INPUT
	int "Button to trigger accelerometer calibration"
	range 1 2 if BOARD_NRF9160_PCA10090NS
	range 1 1 if BOARD_NRF9160_PCA20035NS
	default 1 if BOARD_NRF9160_PCA10090NS
	default 1 if BOARD_NRF9160_PCA20035NS
	help
		Button number to use to trigger accelerometer calibration:
		1 - Button 1
		2 - Button 2
endif

if !ACCEL_CALIBRATE
config ACCEL_CALIBRATION_ITERATIONS
	int
	default 0
endif

config ACCEL_ITERATIONS
	int "Number of readings per measurement"
	default 20 if BOARD_NRF9160_PCA20035NS
	default 1
	help
		Number of measurement readings to average over for each time
		the orientation detector determines the orientation of the
		board. Used for simple filtering of noisy measurements.

endmenu # Motion

menu "Environment sensors"

config USE_BME680_BSEC
	bool "Use Bosch BME680 BSEC lib"
	default n
	help
	  Enable use of Bosch BSEC library. The library itself is not a part of
	  NCS and must be downloaded from Bosch Sensortec.

config BOSCH_BSEC_LIBRARY_PATH
	string "Path to Bosch BSEC library folder"
	default "$(ZEPHYR_BASE)/../nrf/ext/BSEC_1.4.7.4_Generic_Release"
	help
	  Path to the folder where the Bosch BSEC library is placed.

config ENVIRONMENT_DATA_SEND_INTERVAL
	int "Interval in seconds for sending environment data"
	default 30
	help
	  Interval between each sampling and sending of environment sensor data.
	  If the GPS is active, sensor data will not be sent before it is
	  stopped. The unit is seconds.

config ENVIRONMENT_DATA_BACKOFF_TIME
	int "Time to delay sending environment data if GPS active"
	default 20
	help
	  Time in seconds before retrying to send environment sensor data if
	  the GPS is active.

choice
	prompt "Temperature measurement device"
	default TEMP_USE_SIM
	help
		Select which device will provide temperature data.

config TEMP_USE_SIM
	bool "Use simulated temperature data"
	select SENSOR
	select SENSOR_SIM
	help
		Use sensor simulator to generate temperature data to send to
		nRF Cloud.

config TEMP_USE_EXTERNAL
	bool "User provided temperature device"
	help
		The user provides a temperature device that is
		used for temperature measurement.

endchoice

if TEMP_USE_SIM
config TEMP_DEV_NAME
	string
	default SENSOR_SIM_DEV_NAME

config TEMP_TRIGGER
	bool
	default SENSOR_SIM_TRIGGER

config TEMP_SIM_BUTTON
	int "Button or switch to trigger 'data ready' event"
	range 1 4 if BOARD_NRF9160_PCA10090NS
	range 1 1 if BOARD_NRF9160_PCA20035NS
	default 3 if BOARD_NRF9160_PCA10090NS
	default 1 if BOARD_NRF9160_PCA20035NS
	help
		Button or switch number to use for triggering
		a 'data ready' event.
		1 - Button 1
		2 - Button 2
		3 - Switch 1
		4 - Switch 2
endif

if TEMP_USE_EXTERNAL

config TEMP_DEV_NAME
	string "Temperature device name"
	help
		Device from which temperature data will be fetched and
		sent to nRF Cloud.

endif

endmenu # Environment sensors

config USE_AT_HOST
	bool "Enable AT commands"
	default y
	select AT_HOST_LIBRARY
	help
		Enable the AT host library so that AT commands can be sent to and
		received from a serial terminal.

endmenu

menu "Zephyr Kernel"
source "$ZEPHYR_BASE/Kconfig.zephyr"
endmenu
```

## west.yml
```
west:
  url: https://github.com/zephyrproject-rtos/west
  revision: v0.6.0

manifest:
  defaults:
    remote: ncs

  remotes:
    - name: ncs
      url-base: https://github.com/NordicPlayground
    - name: zephyrproject
      url-base: https://github.com/zephyrproject-rtos
    - name: throwtheswitch
      url-base: https://github.com/ThrowTheSwitch
    - name: armmbed
      url-base: https://github.com/ARMmbed

  projects:
    - name: fw-nrfconnect-zephyr
      path: zephyr
      west-commands: scripts/west-commands.yml
      revision: 1c3a001f62e6c51693b67e4f7ee7f66111d31801
    - name: fw-nrfconnect-nrf
      path: nrf
      revision: f99a3a56ac0204c985117c201ac37b050cf6db08
    - name: nrfxlib
      path: nrfxlib
      revision: 35120d32233dc354c89d8c62eaa6267093c7e35b
    - name: fw-nrfconnect-mcuboot
      path: mcuboot
      revision: 0c59d5f4bb2de49b5491b018fc7fd41afc154f1b
    - name: mbedtls
      repo-path: fw-nrfconnect-mbedtls
      path: modules/crypto/mbedtls
      revision: 900c7eea92e45adba1067e044ec705d4541c84a5
    - name: mbedtls-nrf
      path: mbedtls
      repo-path: mbedtls
      revision: mbedtls-2.13.1
      remote: armmbed
```

## prj.conf
```kconfig
CONFIG_AT_CMD=y
CONFIG_AT_CMD_PARSER=y
CONFIG_BSD_LIBRARY=y
CONFIG_SERIAL=y
CONFIG_STDOUT_CONSOLE=y
CONFIG_UART_INTERRUPT_DRIVEN=y
CONFIG_TEST_RANDOM_GENERATOR=y
CONFIG_NETWORKING=y
CONFIG_NET_SOCKETS=y
CONFIG_NET_SOCKETS_POSIX_NAMES=y
CONFIG_MAIN_STACK_SIZE=8192
CONFIG_HEAP_MEM_POOL_SIZE=16384


# Sensors
CONFIG_SENSOR=y
CONFIG_ACCEL_USE_EXTERNAL=y
CONFIG_ACCEL_DEV_NAME="ADXL362"
CONFIG_ADXL362=y
CONFIG_ADXL362_TRIGGER_OWN_THREAD=y
CONFIG_ADXL362_ABS_REF_MODE=1
CONFIG_ADXL362_ACTIVITY_THRESHOLD=200
CONFIG_ADXL362_INACTIVITY_THRESHOLD=200
CONFIG_ADXL362_INTERRUPT_MODE=1
CONFIG_TEMP_USE_EXTERNAL=y
CONFIG_TEMP_DEV_NAME="BME680"

# Deselect CONFIG_BME680 if CONFIG_USE_BME680_BSEC is selected
CONFIG_BME680=y
CONFIG_USE_BME680_BSEC=n

CONFIG_SPI_NRFX_SPIM_MISO_NO_PULL=y

CONFIG_LOG=y
CONFIG_LOG_IMMEDIATE=y
CONFIG_MAIN_THREAD_PRIORITY=7
CONFIG_SYSTEM_WORKQUEUE_STACK_SIZE=2048
CONFIG_HW_STACK_PROTECTION=y

# Library for buttons and LEDs
CONFIG_DK_LIBRARY=y
CONFIG_DK_LIBRARY_INVERT_LEDS=n
```

## src/main.c
```c
/*
 * Copyright (c) 2019 Exploratory Engineering
 */
#include <zephyr.h>
#include <errno.h>
#include <stdio.h>
#include <net/socket.h>
#include <at_cmd.h>
#include <at_cmd_parser.h>

#include "ui.h"
#include "orientation_detector.h"

K_SEM_DEFINE(registered_on_network_sem, 0, 1);

static void at_cmd_notification_handler(char *response) {
	if (memcmp(response, "+CEREG", 6) != 0) {
		return;
	}

	struct at_param_list params = {0};
	if (at_params_list_init(&params, 1) != 0) {
		printf("Error initializing AT param list.\n");
		return;
	}
	if (at_parser_params_from_str(&response[sizeof("+CEREG:")], &params) != 0) {
		printf("Error parsing response: %s\n", response);
		goto cleanup;
	}
	u16_t status = 0;
	if (at_params_short_get(&params, 0, &status) != 0) {
		printf("Error getting short param: %s\n", response);
		goto cleanup;
	}
	if (status == 1) {
		k_sem_give(&registered_on_network_sem);
	}

cleanup:
	at_params_list_free(&params);
}

static bool subscribe_network_status_notifications() {
	if (at_cmd_write("AT+CEREG=1", NULL, 0, NULL) != 0) {
		printf("Error subscribing to network status notifications.\n");
		return false;
	}
	at_cmd_set_notification_handler(at_cmd_notification_handler);
	return true;
}

static bool systemmode_lte() {
	if (at_cmd_write("AT+CFUN=4", NULL, 0, NULL) != 0 ||
		at_cmd_write("AT%XSYSTEMMODE=1,0,0,0", NULL, 0, NULL) != 0 ||
		at_cmd_write("AT+CFUN=1", NULL, 0, NULL) != 0) {
		printf("Error enabling system mode LTE: %d\n", errno);
		return false;
	}

	if (k_sem_take(&registered_on_network_sem, K_SECONDS(60)) != 0) {
		printf("Did not register on network within 60 seconds.\n");
		return false;
	}

	return true;
}

bool print_imei_imsi() {
	char resp[32] = {0};
	int err = at_cmd_write("AT+CGSN", resp, sizeof(resp), NULL);
	if (err != 0) {
		printf("Error getting IMEI: %d.\n", err);
		return false;
	}
	resp[15] = 0;
	printf("IMEI: %s\n", resp);

	err = at_cmd_write("AT+CIMI", resp, sizeof(resp), NULL);
	if (err != 0) {
		printf("Error getting IMSI: %d.\n", err);
		return false;
	}
	resp[15] = 0;
	printf("IMSI: %s\n", resp);

	return true;
}

bool set_apn() {
	if (at_cmd_write("AT+CFUN=1", NULL, 0, NULL) != 0 ||
		at_cmd_write("AT+CGATT=0", NULL, 0, NULL) != 0 ||
		at_cmd_write("AT+CGDCONT=0,\"IP\",\"mda.ee\"", NULL, 0, NULL) != 0 ||
		at_cmd_write("AT+CGDCONT?", NULL, 0, NULL) != 0 ||
		at_cmd_write("AT+CGATT=1", NULL, 0, NULL) != 0) {
		return false;
	}

	if (k_sem_take(&registered_on_network_sem, K_SECONDS(60)) != 0) {
		printf("Did not register on network within 60 seconds.\n");
		return false;
	}

	return true;
}

bool send_message(const char *message) {
	int sock = socket(AF_INET, SOCK_DGRAM, IPPROTO_UDP);
	if (sock < 0) {
		printf("Error opening socket: %d\n", errno);
		return false;
	}

	static struct sockaddr_in remote_addr = {
		sin_family: AF_INET,
		sin_port:   htons(1234),
	};
	net_addr_pton(AF_INET, "172.16.15.14", &remote_addr.sin_addr);

	if (sendto(sock, message, strlen(message), 0, (struct sockaddr *)&remote_addr, sizeof(remote_addr)) < 0) {
		printf("Error sending: %d\n", errno);
		close(sock);
		return false;
	}

	close(sock);
	return true;
}

static struct k_delayed_work flip_work;

static void do_flip_work(struct k_work *work) {
	static enum orientation_state last_orientation_state = ORIENTATION_NOT_KNOWN;
	static struct orientation_detector_sensor_data sensor_data;

	if (orientation_detector_poll(&sensor_data) == 0) {
		if (sensor_data.orientation == last_orientation_state) {
			goto exit;
		}

		if (last_orientation_state != ORIENTATION_NOT_KNOWN) {
			switch (sensor_data.orientation) {
			case ORIENTATION_NORMAL:
				send_message("Right side up.");
				break;
			case ORIENTATION_UPSIDE_DOWN:
				send_message("Upside down.");
				break;
			default:
				goto exit;
			}
		}

		last_orientation_state = sensor_data.orientation;
	}

exit:
	k_delayed_work_submit(&flip_work, K_MSEC(10));
}

/**@brief Initializes flip detection using orientation detector module
 * and configured accelerometer device.
 */
static void flip_detection_init(void)
{
	int err;
	struct device *accel_dev =
		device_get_binding(CONFIG_ACCEL_DEV_NAME);

	if (accel_dev == NULL) {
		printk("Could not get %s device\n", CONFIG_ACCEL_DEV_NAME);
		return;
	}

	orientation_detector_init(accel_dev);

	if (IS_ENABLED(CONFIG_ACCEL_CALIBRATE)) {
		err = orientation_detector_calibrate();
		if (err) {
			printk("Could not calibrate accelerometer device: %d\n", err);
		}
	}

	k_delayed_work_init(&flip_work, do_flip_work);
	k_delayed_work_submit(&flip_work, K_NO_WAIT);
}

void main() {
	printf("Hackathon application started.\n"); 

	ui_init(NULL);
	ui_led_set_pattern(UI_CLOUD_CONNECTING);

	if (!subscribe_network_status_notifications()) {
		goto end;
	}

	if (!systemmode_lte()) {
		printf("Failed to set system mode LTE.\n");
		goto end;
	}

	if (!print_imei_imsi()) {
		printf("Failed to get IMEI/IMSI.\n");
		goto end;
	}

	if (!set_apn()) {
		printf("Failed to set APN.\n");
		goto end;
	}
	printf("Connected!\n"); 
	ui_led_set_pattern(UI_CLOUD_CONNECTED);

	flip_detection_init();
	printf("Flip detection initialized.\n");

	return;

end:
	printf("Hackathon application complete.\n"); 
}
```
